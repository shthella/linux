/include/ "system-conf.dtsi"
/ {
	axi {
        	 serial1_uart:serial@ff010000 {
            		compatible = "my_uart";
            		reg = <0x00000000 0xff010000 0x00000000 0x00001000>;
            		interrupts = <0x00 0x16 0x04>;
       		};
       		ttyphani@0 {
        			compatible = "customttyphani";
        			status = "okay";
        			uart = <&serial1_uart>;
        			depends-on = <&serial1_uart>;
   		 };
    	};
};
